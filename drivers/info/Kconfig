## drivers/info/Kconfig
```kconfig
menu "BBK Driver Info class support"
config BBK_INFO
	tristate "BBK Info class config"
	help
	  Say Y here to enable driver info class support.
if BBK_INFO

config BBK_DRIVER_INFO
	tristate "GPIO Driver Info"
	help
	  Say Y here to enable bbk driver info interface.

config BBK_CARD_DETECT
	tristate "GPIO Driver Info"
	help
	  Say Y here to enable bbk driver info interface.

config BBK_BOARDS_VERSION
	tristate "GPIO Driver Info"
	help
	  Say Y here to enable bbk driver info interface.

endif # SWITCH
#add by huaqin for simtray detect start
config BBK_SIMTRAY_STATUS_DETECT
	tristate "SIM tray status"
	help
	  Say y here to enable SIM tray GPIO detection
#add by huaqin for simtray detect end
endmenu
```

## drivers/input/fingerprint/Kconfig
```kconfig
menuconfig BBK_FINGERPRINT
	tristate "BBK FINGERPRINT support"
	help
	  Say Y here to enable fingerprint

if BBK_FINGERPRINT
config BBK_FP_MODULE
	bool "BBK fingerprint modules"
	help 
	  Say Y here to enable fingerprint modules
	
config BBK_FP_ID
	tristate "detect fingerprint id"
	help
	  there is nothing for help!

source "drivers/input/fingerprint/gf3208/Kconfig"

source "drivers/input/fingerprint/fpc1511/Kconfig"

source "drivers/input/fingerprint/ft9391/Kconfig"

source "drivers/input/fingerprint/gf3626/Kconfig"

source "drivers/input/fingerprint/icnf7312/Kconfig"
endif
```

## drivers/input/fingerprint/gf3626/Kconfig
```kconfig
config BBK_GF3626
	tristate "Goodix GF3626 fingerprint drvier support"
	help
	  Say Y here to enable goodix fingerprint driver support!
```

## drivers/input/fingerprint/icnf7312/Kconfig
```kconfig
#
# CHIPONE sensors
#
config BBK_ICNF7312
    tristate " fingerprint sensor IRQ support"
    help
		If you say yes here you get IRQ support for the fingerprint ).
```
